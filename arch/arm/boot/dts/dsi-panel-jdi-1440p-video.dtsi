/* Copyright (c) 2013, The Linux Foundation. All rights reserved.
 *
 * This program is free software; you can redistribute it and/or modify
 * it under the terms of the GNU General Public License version 2 and
 * only version 2 as published by the Free Software Foundation.
 *
 * This program is distributed in the hope that it will be useful,
 * but WITHOUT ANY WARRANTY; without even the implied warranty of
 * MERCHANTABILITY or FITNESS FOR A PARTICULAR PURPOSE.  See the
 * GNU General Public License for more details.
 */

/*---------------------------------------------------------------------------
 * This file is autogenerated file using gcdb parser. Please do not edit it.
 * Update input XML file to add a new entry or update variable in this file
 * VERSION = "1.0"
 *---------------------------------------------------------------------------*/
&mdss_mdp {
	dsi_jdi_1440_vid: qcom,mdss_dsi_jdi_1440p_video {
		compatible = "qcom,mdss-dsi-panel";
		status = "ok";
		qcom,cont-splash-enabled;
		qcom,mdss-dsi-panel-name = "jdi 1440p video mode dsi panel1";
		qcom,mdss-dsi-panel-manufacture = "JDI";
		qcom,mdss-dsi-panel-version = "R63319";
		qcom,mdss-dsi-panel-controller = <&mdss_dsi0>;
		qcom,mdss-dsi-panel-type = "dsi_video_mode";
		qcom,mdss-dsi-panel-destination = "display_1";
		qcom,mdss-dsi-panel-frame-rate = <55>;
		qcom,mdss-dsi-virtual-channel-id = <0>;
		qcom,mdss-dsi-stream = <0>;
		qcom,mdss-dsi-panel-width = <720>;
		qcom,mdss-dsi-panel-height = <2560>;
		qcom,mdss-dsi-h-front-porch = <200>;
		qcom,mdss-dsi-h-back-porch = <200>;
		qcom,mdss-dsi-h-pulse-width = <2>;
		qcom,mdss-dsi-h-sync-skew = <0>;
		qcom,mdss-dsi-v-back-porch = <6>;
		qcom,mdss-dsi-v-front-porch = <4>;
		qcom,mdss-dsi-v-pulse-width = <1>;
		qcom,mdss-dsi-h-left-border = <0>;
		qcom,mdss-dsi-h-right-border = <0>;
		qcom,mdss-dsi-v-top-border = <0>;
		qcom,mdss-dsi-v-bottom-border = <0>;
		qcom,mdss-dsi-bpp = <24>;
		qcom,mdss-dsi-color-order = <0>;
		qcom,mdss-dsi-underflow-color = <0xff>;
		qcom,mdss-dsi-border-color = <0>;
		qcom,mdss-dsi-on-command = [29 01 00 00 01 00 06 F0 55 AA 52 08 00
									23 01 00 00 01 00 02 B1 21
									29 01 00 00 01 00 04 B4 25 02 8C
									29 01 00 00 01 00 06 B2 08 20 01 00 1B
									29 01 00 00 01 00 03 B8 00 01
									29 01 00 00 01 00 0A B9 00 00 18 00 00 44 12 12 00
									29 01 00 00 01 00 03 BA 00 11
									29 01 00 00 01 00 03 BC 4F 00
									29 01 00 00 01 00 05 BD 00 C1 07 04
									29 01 00 00 01 00 04 D4 02 03 37									
									29 01 00 00 01 00 07 CC 41 36 87 11 11 11
									29 01 00 00 01 00 0D CE 11 11 11 11 11 11 10 10 10 10 10 10
									15 01 00 00 01 00 02 6F 0E
									15 01 00 00 01 00 02 E5 1D	
									29 01 00 00 01 00 06 F0 55 AA 52 08 01
									29 01 00 00 01 00 03 B0 0A 0A
									29 01 00 00 01 00 03 B1 95 95
									29 01 00 00 01 00 07 B2 05 09 05 09 05 09
									29 01 00 00 01 00 07 B3 32 1E 32 1E 32 1E
									29 01 00 00 01 00 07 B6 13 13 13 13 13 13
									29 01 00 00 01 00 03 BC 41 00
									29 01 00 00 01 00 03 BD 41 00
									23 01 00 00 01 00 02 C0 22
									23 01 00 00 01 00 02 C1 02
									23 01 00 00 01 00 02 CA 0F
									29 01 00 00 01 00 06 F0 55 AA 52 08 02
									29 01 00 00 01 00 0F B0 01 02 03 3F 41 42 46 2C 27 24 25 3C 49 4A 
									29 01 00 00 01 00 10 B1 48 5A 71 73 86 90 A2 A5 AF BB C7 D4 E4 F6 FF 
									29 01 00 00 01 00 0F B2 2D 2E 2F 30 3C 46 4F 38 35 37 34 46 53 50
									29 01 00 00 01 00 10 B3 4C 5E 75 77 8A 92 A1 A3 AD B8 C4 D1 E1 F5 FF
									29 01 00 00 01 00 0F B4 01 02 03 04 05 06 07 01 00 0C 12 2E 40 43
									29 01 00 00 01 00 10 B5 48 5A 71 73 86 8C 97 99 A2 AD B8 C6 D9 F2 FF
									29 01 00 00 01 00 0F B6 01 02 03 3F 41 42 46 2C 27 24 25 3C 49 4A
									29 01 00 00 01 00 10 B7 48 5A 71 73 86 90 A2 A5 AF BB C7 D4 E4 F6 FF
									29 01 00 00 01 00 0F B8 2D 2E 2F 30 3C 46 4F 38 35 37 34 46 53 50
									29 01 00 00 01 00 10 B9 4C 5E 75 77 8A 92 A1 A3 AD B8 C4 D1 E1 F5 FF
									29 01 00 00 01 00 0F BA 01 02 03 04 05 06 07 01 00 0C 12 2E 40 43
									29 01 00 00 01 00 10 BB 48 5A 71 73 86 8C 97 99 A2 AD B8 C6 D9 F2 FF
									29 01 00 00 01 00 10 BE 00 00 00 00 00 00 00 00 00 00 00 00 00 00 00
									29 01 00 00 01 00 0B BF 00 00 00 00 00 00 00 00 00 00
									29 01 00 00 01 00 06 F0 55 AA 52 08 03
									29 01 00 00 01 00 05 B0 00 00 00 00
									29 01 00 00 01 00 05 B1 00 00 00 00
									29 01 00 00 01 00 08 B2 00 00 00 00 00 02 22
									29 01 00 00 01 00 03 B4 00 00
									29 01 00 00 01 00 05 B5 09 25 08 00
									29 01 00 00 01 00 06 BA 11 00 08 00 A3
									29 01 00 00 01 00 06 BB 31 10 00 00 00
									29 01 00 00 01 00 06 BE 11 00 8E 00 AE
									29 01 00 00 01 00 06 F0 55 AA 02 08 05
									29 01 00 00 01 00 04 B0 33 11 07
									29 01 00 00 01 00 03 B2 06 10
									29 01 00 00 01 00 04 B3 50 30 00
									23 01 00 00 01 00 02 B4 16
									29 01 00 00 01 00 04 B5 06 10 00
									29 01 00 00 01 00 04 B6 06 10 00
									29 01 00 00 01 00 04 B9 06 10 00
									29 01 00 00 01 00 06 BA 06 00 00 10 00
									29 01 00 00 01 00 06 BB 0E 00 00 10 00
									29 01 00 00 01 00 04 C0 6D 39 E8
									29 01 00 00 01 00 03 C8 01 10
									29 01 00 00 01 00 03 C9 00 10
									29 01 00 00 01 00 03 CC 01 10
									29 01 00 00 01 00 06 D0 02 0A 00 01 92
									29 01 00 00 01 00 06 D1 02 0A 00 00 92
									29 01 00 00 01 00 06 D4 00 0A 01 00 92
									23 01 00 00 01 00 02 EC 11
									29 01 00 00 01 00 06 F0 55 AA 52 08 06
									29 01 00 00 01 00 06 B0 00 11 08 04 05
									29 01 00 00 01 00 06 B1 1F 26 12 19 1B
									29 01 00 00 01 00 06 B2 1D 1A 1C 1E 1F
									29 01 00 00 01 00 06 B3 1F 1F 1F 1F 1F
									29 01 00 00 01 00 06 B4 1F 1F 1F 1F 1F
									29 01 00 00 01 00 04 B5 1F 1F 1F
									29 01 00 00 01 00 06 B6 00 11 08 04 05
									29 01 00 00 01 00 06 B7 1F 26 12 19 1B
									29 01 00 00 01 00 06 B8 1D 1A 1C 1E 1F
									29 01 00 00 01 00 06 B9 1F 1F 1F 1F 1F
									29 01 00 00 01 00 06 BA 1F 1F 1F 1F 1F
									29 01 00 00 01 00 04 BB 1F 1F 1F
									29 01 00 00 01 00 06 C0 00 12 09 05 04
									29 01 00 00 01 00 06 C1 1F 26 12 19 1B
									29 01 00 00 01 00 06 C2 1D 1A 1C 1E 1F
									29 01 00 00 01 00 06 C3 1F 1F 1F 1F 1F
									29 01 00 00 01 00 06 C4 1F 1F 1F 1F 1F
									29 01 00 00 01 00 04 C5 1F 1F 1F
									29 01 00 00 01 00 06 C6 00 12 09 05 04
									29 01 00 00 01 00 06 C7 1F 26 12 19 1B
									29 01 00 00 01 00 06 C8 1D 1A 1C 1E 1F
									29 01 00 00 01 00 06 C9 1F 1F 1F 1F 1F
									29 01 00 00 01 00 06 CA 1F 1F 1F 1F 1F
									29 01 00 00 01 00 04 CB 1F 1F 1F
									29 01 00 00 01 00 04 D0 00 AA AA									
									29 01 00 00 01 00 05 FF AA 55 A5 80
									15 01 00 00 01 00 02 6F 10
									15 01 00 00 01 00 02 FA 02
									15 01 00 00 01 00 02 6F 0A
									15 01 00 00 01 00 02 F8 00
									15 01 00 00 01 00 02 6F 02
									15 01 00 00 01 00 02 F7 77
									29 01 00 00 01 00 05 FF AA 55 A5 00									
									15 01 00 00 01 00 02 35 00
									05 01 00 00 78 00 02 11 00
									05 01 00 00 28 00 02 29 00
									39 01 00 00 01 00 02 51 ff
									15 01 00 00 01 00 02 53 2C
									15 01 00 00 01 00 02 55 93];
		qcom,mdss-dsi-off-command = [05 01 00 00 32 00 02 28 00
					05 01 00 00 78 00 02 10 00];
		qcom,mdss-dsi-on-command-state = "dsi_lp_mode";
		qcom,mdss-dsi-off-command-state = "dsi_hs_mode";
		qcom,mdss-dsi-h-sync-pulse = <0>;
		qcom,mdss-dsi-traffic-mode = "burst_mode";
		qcom,mdss-dsi-lane-map = <0>;
		qcom,mdss-dsi-bllp-eof-power-mode;
		qcom,mdss-dsi-bllp-power-mode;
		qcom,mdss-dsi-lane-0-state;
		qcom,mdss-dsi-lane-1-state;
		qcom,mdss-dsi-lane-2-state;
		qcom,mdss-dsi-lane-3-state;
		qcom,mdss-dsi-panel-timings = [ef 38 25 00 67 70 29 3c 2c 03 04 00];
		qcom,mdss-dsi-t-clk-post = <0x20>;
		qcom,mdss-dsi-t-clk-pre = <0x3e>;
		qcom,mdss-dsi-bl-min-level = <1>;
		qcom,mdss-dsi-bl-max-level = <255>;
		qcom,mdss-dsi-dma-trigger = "trigger_sw";
		qcom,mdss-dsi-mdp-trigger = "none";
		qcom,mdss-dsi-bl-pmic-control-type = "bl_ctrl_wled";
		qcom,mdss-dsi-reset-sequence = <1 20>, <0 200>, <1 20>;
		qcom,mdss-dsi-cabc-off-command = [05 01 00 00 10 00 02 29 00
										  15 01 00 00 10 00 02 55 90];
		qcom,mdss-dsi-cabc-ui-command = [05 01 00 00 10 00 02 29 00
										 15 01 00 00 10 00 02 55 91];
		qcom,mdss-dsi-cabc-still-image-command = [05 01 00 00 10 00 02 29 00
												  15 01 00 00 10 00 02 55 92];
		qcom,mdss-dsi-cabc-video-command = [05 01 00 00 10 00 02 29 00
											15 01 00 00 10 00 02 55 93];
	};
	
	dsi_jdi_1440_vid2: qcom,mdss_dsi_jdi_1440p_video2 {
		compatible = "qcom,mdss-dsi-panel2";
		status = "ok";
		qcom,cont-splash-enabled;
		qcom,mdss-dsi-panel-name = "jdi 1440p video mode dsi panel2";
		qcom,mdss-dsi-panel-manufacture = "JDI";
		qcom,mdss-dsi-panel-version = "R63319";
		qcom,mdss-dsi-panel-controller = <&mdss_dsi1>;
		qcom,mdss-dsi-panel-type = "dsi_video_mode";
		qcom,mdss-dsi-panel-destination = "display_2";
		qcom,mdss-dsi-panel-frame-rate = <55>;
		qcom,mdss-dsi-virtual-channel-id = <0>;
		qcom,mdss-dsi-stream = <0>;
		qcom,mdss-dsi-panel-width = <720>;
		qcom,mdss-dsi-panel-height = <2560>;
		qcom,mdss-dsi-h-front-porch = <200>;
		qcom,mdss-dsi-h-back-porch = <200>;
		qcom,mdss-dsi-h-pulse-width = <2>;
		qcom,mdss-dsi-h-sync-skew = <0>;
		qcom,mdss-dsi-v-back-porch = <6>;
		qcom,mdss-dsi-v-front-porch = <4>;
		qcom,mdss-dsi-v-pulse-width = <1>;
		qcom,mdss-dsi-h-left-border = <0>;
		qcom,mdss-dsi-h-right-border = <0>;
		qcom,mdss-dsi-v-top-border = <0>;
		qcom,mdss-dsi-v-bottom-border = <0>;
		qcom,mdss-dsi-bpp = <24>;
		qcom,mdss-dsi-color-order = <0>;
		qcom,mdss-dsi-underflow-color = <0xff>;
		qcom,mdss-dsi-border-color = <0>;
		qcom,mdss-dsi-h-sync-pulse = <0>;
		qcom,mdss-dsi-traffic-mode = "burst_mode";
		qcom,mdss-dsi-lane-map = <0>;
		qcom,mdss-dsi-bllp-eof-power-mode;
		qcom,mdss-dsi-bllp-power-mode;
		qcom,mdss-dsi-lane-0-state;
		qcom,mdss-dsi-lane-1-state;
		qcom,mdss-dsi-lane-2-state;
		qcom,mdss-dsi-lane-3-state;
		qcom,mdss-dsi-panel-timings = [ef 38 25 00 67 70 29 3c 2c 03 04 00];
		qcom,mdss-dsi-t-clk-post = <0x20>;
		qcom,mdss-dsi-t-clk-pre = <0x3e>;
		qcom,mdss-dsi-bl-min-level = <1>;
		qcom,mdss-dsi-bl-max-level = <255>;
		qcom,mdss-dsi-dma-trigger = "trigger_sw";
		qcom,mdss-dsi-mdp-trigger = "none";
		qcom,mdss-dsi-bl-pmic-control-type = "bl_ctrl_wled";
		qcom,mdss-dsi-reset-sequence = <1 20>, <0 200>, <1 20>;
	};
};
