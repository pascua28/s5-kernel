/* Copyright (c) 2012-2013, The Linux Foundation. All rights reserved.
 *
 * This program is free software; you can redistribute it and/or modify
 * it under the terms of the GNU General Public License version 2 and
 * only version 2 as published by the Free Software Foundation.
 *
 * This program is distributed in the hope that it will be useful,
 * but WITHOUT ANY WARRANTY; without even the implied warranty of
 * MERCHANTABILITY or FITNESS FOR A PARTICULAR PURPOSE.  See the
 * GNU General Public License for more details.
 */

&pm8941_lsid0 {
	pm8941_clkdiv1: clkdiv@5b00 {
		qcom,cxo-div = <2>;
	};

		pm8941_clkdiv2: clkdiv@5c00 {
		/*VENDOR_EDIT*/
		/*liuyan 2013-9-12 add for es325*/
		/*reg = <0x5c00 0x1000>;
		qcom,cxo-freq = <19200000>;*/
		qcom,cxo-div = <1>;
		/*qcom,enable = <1>;*/
		/*liuyan add end*/
		};

	pm8941_clkdiv3: clkdiv@5d00 {
	};
};
