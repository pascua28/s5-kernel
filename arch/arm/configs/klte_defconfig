## arch/arm/hotplug/Kconfig
```kconfig
config INTELLI_PLUG
        bool "Enable intelli-plug cpu hotplug driver"
        default n
        help
          Generic Intelli-plug cpu hotplug driver for ARM SOCs

config MAKO_HOTPLUG
	bool "Mako Hotplug"
	default y
	help
	  Mako Hotplug: A custom hotplug by fransisco franco
```

## arch/arm/mach-msm/klte/Kconfig
```kconfig
config MACH_KLTE
	bool
	depends on ARCH_MSM

config MSM_SAMSUNG_KLTE
	depends on ARCH_MSM8974
	select MACH_KLTE
	bool "Samsung KLTE MSM8974 Platform"
	help
	  Support for Samsung MSM8974 device.
```

## drivers/backoff/Kconfig
```kconfig
menu "Suspend backoff"

config SUSPEND_BACKOFF
	bool "Suspend backoff"
	help
          Holds a wakelock if you suspend too often

endmenu
```

## drivers/cpuquiet/Kconfig
```kconfig
menu "CPUQUIET Framework"

config CPUQUIET_FRAMEWORK
	bool "Cpuquiet framework"
	help
	  Cpuquiet implements pluggable policies for forcing cpu cores into a
	  quiescent state. Appropriate policies will save power without hurting
	  performance.

if CPUQUIET_FRAMEWORK

choice
	prompt "Default CPUQuiet governor"
	help
	  This option sets which CPUQuiet governor shall be loaded at
	  startup. If in doubt, select 'balanced'

config CPUQUIET_DEFAULT_GOV_BALANCED
	bool "balanced"
	select CPUQUIET_GOVERNOR_BALANCED
	depends on CPU_FREQ
	help
	  Use the CPUQuiet governor 'balanced' as default. This dynamically
	  scales the number of cpus online in the system based on the cpu
	  load

config CPUQUIET_DEFAULT_GOV_RUNNABLE
	bool "runnable"
	select CPUQUIET_GOVERNOR_RUNNABLE
	help
	  Use the CPUQuiet governor 'runnable' as default. This uses
	  the number of running threads ato scale the number of cpus  
	  online in the system
	  
config CPUQUIET_DEFAULT_GOV_RQ_STATS
	bool "rq_stats"
	select CPUQUIET_GOVERNOR_RQ_STATS
	help
	  Use the CPUQuiet governor 'rq_stats' as default. This uses
	  rq information to scale the number of cpus online in the system

config CPUQUIET_DEFAULT_GOV_LOAD_STATS
	bool "load_stats"
	select CPUQUIET_GOVERNOR_LOAD_STATS
	help
	  Use the CPUQuiet governor 'load_stats' as default
	  
endchoice

config CPUQUIET_GOVERNOR_BALANCED
	bool "balanced"
	depends on CPU_FREQ
	help
	  Add the CPUQuiet governor 'balanced'

config CPUQUIET_GOVERNOR_RUNNABLE
	bool "runnable"
	help
	  Add the CPUQuiet governor 'runnable'

config CPUQUIET_GOVERNOR_RQ_STATS
	bool "rq_stats"
	help
	  Add the CPUQuiet governor 'rq_stats'

config CPUQUIET_GOVERNOR_LOAD_STATS
	bool "load_stats"
	help
	  Add the CPUQuiet governor 'load_stats'

endif
endmenu
```

## drivers/media/Kconfig
```kconfig
#
# Multimedia device configuration
#

menuconfig MEDIA_SUPPORT
	tristate "Multimedia support"
	depends on HAS_IOMEM
	help
	  If you want to use Video for Linux, DVB for Linux, or DAB adapters,
	  enable this option and other options below.

if MEDIA_SUPPORT

comment "Multimedia core support"

#
# Media controller
#

config MEDIA_CONTROLLER
	bool "Media Controller API (EXPERIMENTAL)"
	depends on EXPERIMENTAL
	---help---
	  Enable the media controller API used to query media devices internal
	  topology and configure it dynamically.

	  This API is mostly used by camera interfaces in embedded platforms.

#
# V4L core and enabled API's
#

config VIDEO_DEV
	tristate "Video For Linux"
	---help---
	  V4L core support for video capture and overlay devices, webcams and
	  AM/FM radio cards.

	  This kernel includes support for the new Video for Linux Two API,
	  (V4L2).

	  Additional info and docs are available on the web at
	  <http://linuxtv.org>

	  Documentation for V4L2 is also available on the web at
	  <http://bytesex.org/v4l/>.

	  To compile this driver as a module, choose M here: the
	  module will be called videodev.

config VIDEO_V4L2_SUBDEV_API
	bool "V4L2 sub-device userspace API (EXPERIMENTAL)"
	depends on VIDEO_DEV && MEDIA_CONTROLLER && EXPERIMENTAL
	---help---
	  Enables the V4L2 sub-device pad-level userspace API used to configure
	  video format, size and frame rate between hardware blocks.

	  This API is mostly used by camera interfaces in embedded platforms.

source "drivers/media/v4l2-core/Kconfig"

#
# DVB Core
#

config DVB_CORE
	tristate "DVB for Linux"
	select CRC32
	help
	  DVB core utility functions for device handling, software fallbacks etc.

	  Enable this if you own a DVB/ATSC adapter and want to use it or if
	  you compile Linux for a digital SetTopBox.

	  Say Y when you have a DVB or an ATSC card and want to use it.

	  API specs and user tools are available from <http://www.linuxtv.org/>.

	  Please report problems regarding this support to the LinuxDVB
	  mailing list.

	  If unsure say N.

config DVB_NET
	bool "DVB Network Support"
	default (NET && INET)
	depends on NET && INET && DVB_CORE
	help
	  This option enables DVB Network Support which is a part of the DVB
	  standard. It is used, for example, by automatic firmware updates used
	  on Set-Top-Boxes. It can also be used to access the Internet via the
	  DVB card, if the network provider supports it.

	  You may want to disable the network support on embedded devices. If
	  unsure say Y.

source "drivers/media/dvb-core/Kconfig"

config VIDEO_MEDIA
	tristate
	default (DVB_CORE && (VIDEO_DEV = n)) || (VIDEO_DEV && (DVB_CORE = n)) || (DVB_CORE && VIDEO_DEV)

comment "Multimedia drivers"

source "drivers/media/common/Kconfig"
source "drivers/media/rc/Kconfig"

source "drivers/media/platform/Kconfig"

#
# Tuner drivers for DVB and V4L
#

source "drivers/media/tuners/Kconfig"

source "drivers/media/i2c/Kconfig"

#
# V4L platform/mem2mem drivers
#
source "drivers/media/video/Kconfig"

source "drivers/media/radio/Kconfig"

source "drivers/media/pci/Kconfig"
source "drivers/media/usb/Kconfig"
source "drivers/media/mmc/Kconfig"

#
# TDMB drivers
#

source "drivers/media/tdmb/Kconfig"

#
# ISDB-Tmm Drivers
#
source "drivers/media/isdbtmm/Kconfig"

config MEDIA_SUBDRV_AUTOSELECT
	bool "Autoselect analog and hybrid tuner modules to build"
	depends on MEDIA_TUNER
	default y
	help
	  By default, a TV driver auto-selects all possible tuners
	  thar could be used by the driver.

	  This is generally the right thing to do, except when there
	  are strict constraints with regards to the kernel size.

	  Use this option with care, as deselecting tuner drivers which
	  are in fact necessary will result in TV devices which cannot
	  be tuned due to lack of the tuning driver.

	  If unsure say Y.

comment "Media ancillary drivers (tuners, sensors, i2c, frontends)"

source "drivers/media/i2c/Kconfig"
source "drivers/media/tuners/Kconfig"
source "drivers/media/dvb-frontends/Kconfig"

# Common drivers
source "drivers/media/common/Kconfig"

endif # MEDIA_SUPPORT
```

## drivers/media/common/Kconfig
```kconfig
config VIDEO_SAA7146
	tristate
	depends on I2C && PCI

config VIDEO_SAA7146_VV
	tristate
	depends on VIDEO_V4L2
	select VIDEOBUF_DMA_SG
	select VIDEO_SAA7146

# Used by common drivers, when they need to ask questions
config MEDIA_COMMON_OPTIONS
	bool

comment "common driver options"
	depends on MEDIA_COMMON_OPTIONS

config VIDEO_CX2341X
	tristate

config VIDEO_BTCX
	depends on PCI
	tristate

config VIDEO_TVEEPROM
	tristate
	depends on I2C

config CYPRESS_FIRMWARE
	tristate "Cypress firmware helper routines"
	depends on USB

source "drivers/media/common/b2c2/Kconfig"
source "drivers/media/common/siano/Kconfig"
```

## drivers/thermal/Kconfig
```kconfig
#
# Generic thermal sysfs drivers configuration
#

menuconfig THERMAL
	tristate "Generic Thermal sysfs driver"
	help
	  Generic Thermal Sysfs driver offers a generic mechanism for
	  thermal management. Usually it's made up of one or more thermal
	  zone and cooling device.
	  Each thermal zone contains its own temperature, trip points,
	  cooling devices.
	  All platforms with ACPI thermal support can use this driver.
	  If you want this support, you should say Y or M here.

if THERMAL

config THERMAL_HWMON
	bool
	depends on HWMON=y || HWMON=THERMAL
	default y

config THERMAL_MSM_POPMEM
	tristate "Qualcomm MSM POP memory temperature sensor"
	depends on THERMAL
	default n
	help
	  This enables a thermal sysfs driver for MSM POP memory. It shows up in
	  sysfs as a thermal zone with one trip point. Due to hardware
	  limitations, the temperatures are reported as "Low Temperature" (20 C)
	  "Normal Temperature" (50 C) and "Out of Spec High Temperature" (85 C).
	  This driver is designed to be used in conjunction with a user space
	  application to make all policy decisions.

config THERMAL_TSENS
	tristate "Qualcomm Tsens Temperature Alarm"
	depends on THERMAL
	default n
	help
	  This enables the thermal sysfs driver for the Tsens device. It shows
	  up in Sysfs as a thermal zone with mutiple trip points. Disabling the
	  thermal zone device via the mode file results in disabling the sensor.
	  Also able to set threshold temperature for both hot and cold and update
	  when a threshold is reached.

config THERMAL_TSENS8960
	tristate "Qualcomm 8960 Tsens Temperature Alarm"
	depends on THERMAL
	help
	  This enables the thermal sysfs driver for the Tsens device. It shows
	  up in Sysfs as a thermal zone with mutiple trip points. Disabling the
	  thermal zone device via the mode file results in disabling the sensor.
	  Also able to set threshold temperature for both hot and cold and update
	  when a threshold is reached.

config THERMAL_TSENS8974
	tristate "Qualcomm 8974 TSENS Temperature driver"
	depends on THERMAL
	help
	  This enables the thermal sysfs driver for the TSENS device. It shows
	  up in Sysfs as a thermal zone with multiple trip points. Also able
	  to set threshold temperature for both warm and cool and update
	  thermal userspace client when a threshold is reached. Warm/Cool
	  temperature thresholds can be set independently for each sensor.

config THERMAL_PM8XXX
	tristate "Qualcomm PMIC PM8xxx Temperature Alarm"
	depends on THERMAL
	depends on MFD_PM8XXX
	help
	  This enables a thermal Sysfs driver for the PMIC PM8xxx devices. It
	  shows up in Sysfs as a thermal zone with multiple trip points.
	  Enabling the thermal zone device via the mode file results in
	  shifting over temperature shutdown control of the PMIC from hardware
	  to software.

config THERMAL_MONITOR
	bool "Monitor thermal state and limit CPU Frequency"
	depends on THERMAL_TSENS8960 || THERMAL_TSENS8974
	depends on CPU_FREQ_MSM
	default n
	help
	  This enables thermal monitoring capability in the kernel in the
	  absence of a system wide thermal monitoring entity or until such an
	  entity starts running in the userspace. Monitors TSENS temperature
	  and limits the max frequency of the cores.

choice
	prompt "Default Thermal governor"
	default THERMAL_DEFAULT_GOV_STEP_WISE
	help
	  This option sets which thermal governor shall be loaded at
	  startup. If in doubt, select 'step_wise'.

config THERMAL_DEFAULT_GOV_STEP_WISE
	bool "step_wise"
	select STEP_WISE
	help
	  Use the step_wise governor as default. This throttles the
	  devices one step at a time.

config THERMAL_DEFAULT_GOV_FAIR_SHARE
	bool "fair_share"
	select FAIR_SHARE
	help
	  Use the fair_share governor as default. This throttles the
	  devices based on their 'contribution' to a zone. The
	  contribution should be provided through platform data.

config THERMAL_DEFAULT_GOV_USER_SPACE
	bool "user_space"
	select USER_SPACE
	help
	  Select this if you want to let the user space manage the
	  lpatform thermals.

endchoice

config FAIR_SHARE
	bool "Fair-share thermal governor"
	help
	  Enable this to manage platform thermals using fair-share governor.

config STEP_WISE
	bool "Step_wise thermal governor"
	help
	  Enable this to manage platform thermals using a simple linear

config USER_SPACE
	bool "User_space thermal governor"
	help
	  Enable this to let the user space manage the platform thermals.

config CPU_THERMAL
	bool "generic cpu cooling support"
	depends on CPU_FREQ
	select CPU_FREQ_TABLE
	help
	  This implements the generic cpu cooling mechanism through frequency
	  reduction, cpu hotplug and any other ways of reducing temperature. An
	  ACPI version of this already exists(drivers/acpi/processor_thermal.c).
	  This will be useful for platforms using the generic thermal interface
	  and not the ACPI interface.
	  If you want this support, you should say Y here.

config SPEAR_THERMAL
	bool "SPEAr thermal sensor driver"
	depends on PLAT_SPEAR
	depends on OF
	help
	  Enable this to plug the SPEAr thermal sensor driver into the Linux
	  thermal framework

config THERMAL_QPNP
	tristate "Qualcomm Plug-and-Play PMIC Temperature Alarm"
	depends on THERMAL
	depends on OF
	depends on SPMI
	depends on OF_SPMI
	help
	  This enables a thermal Sysfs driver for Qualcomm plug-and-play (QPNP)
	  PMIC devices. It shows up in Sysfs as a thermal zone with multiple
	  trip points. The temperature reported by the thermal zone reflects the
	  real time die temperature if an ADC is present or an estimate of the
	  temperature based upon the over temperature stage value if no ADC is
	  available. If allowed via compile time configuration; enabling the
	  thermal zone device via the mode file results in shifting PMIC over
	  temperature shutdown control from hardware to software.

config THERMAL_QPNP_ADC_TM
	tristate "Qualcomm 8974 Thermal Monitor ADC Driver"
	depends on THERMAL && SPMI
	help
	  This enables the thermal Sysfs driver for the ADC thermal monitoring
	  device. It shows up in Sysfs as a thermal zone with multiple trip points.
	  Disabling the thermal zone device via the mode file results in disabling
	  the sensor. Also able to set threshold temperature for both hot and cold
	  and update when a threshold is reached.

config RCAR_THERMAL
	tristate "Renesas R-Car thermal driver"
	depends on ARCH_SHMOBILE
	help
	  Enable this to plug the R-Car thermal sensor driver into the Linux
	  thermal framework

config EXYNOS_THERMAL
	tristate "Temperature sensor on Samsung EXYNOS"
	depends on (ARCH_EXYNOS4 || ARCH_EXYNOS5)
	select CPU_FREQ_TABLE
	help
	  If you say yes here you get support for TMU (Thermal Managment
	  Unit) on SAMSUNG EXYNOS series of SoC.


endif
```

## drivers/usb/notify/Kconfig
```kconfig
#
# USB Host notify configuration
#

config USB_HOST_NOTIFY
	bool "USB Host notify Driver"
	depends on USB
	help
	  Android framework needs uevents for usb host operation.
	  Host notify Driver serves uevent format
	  that is used by usb host or otg.

config USB_DEBUG_DETEAILED_LOG
	bool "USB detailed log for debugging"
	depends on USB
	help
	  Add detailed log for debugging.
```
